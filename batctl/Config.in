## batctl/Config.in
```kconfig
config KMOD_BATMAN_ADV_DEVEL_BATCTL
	bool "enable batctl"
	depends PACKAGE_kmod-batman-adv-devel
	default y
	help
	  batctl is a more intuitive managment utility for B.A.T.M.A.N.-Advanced.
	  It is an easier method for configuring batman-adv and
	  provides some additional tools for debugging as well.
```

## batman-adv/Config.in
```kconfig
config KMOD_BATMAN_ADV_DEVEL_DEBUG_LOG
	bool "enable verbose debug logging"
	depends PACKAGE_kmod-batman-adv-devel
	default n
	help
	  Compile the batman-adv module with debugging enabled
```
